#include <LEDMatrixDriver.hpp>
#include <Wire.h> 
#include <RtcDS1307.h>


RtcDS1307<TwoWire> Rtc(Wire);
const uint8_t LEDMATRIX_CS_PIN = 10;

const int LEDMATRIX_SEGMENTS = 4;
const int LEDMATRIX_WIDTH    = LEDMATRIX_SEGMENTS * 8;

LEDMatrixDriver lmd(LEDMATRIX_SEGMENTS, LEDMATRIX_CS_PIN);

const int ANIM_DELAY = 30;

void setup() {
      Serial.begin(57600);

    Serial.print("compiled: ");
    Serial.print(__DATE__);
    Serial.println(__TIME__);

        Rtc.Begin();

    RtcDateTime compiled = RtcDateTime(__DATE__, __TIME__);
    printDateTime(compiled);
    Serial.println();

    if (!Rtc.IsDateTimeValid()) 
    {
        if (Rtc.LastError() != 0)
        {
            Serial.print("RTC communications error = ");
            Serial.println(Rtc.LastError());
        }
        else
        {
            Serial.println("RTC lost confidence in the DateTime!");
            Rtc.SetDateTime(compiled);
        }
    }

    if (!Rtc.GetIsRunning())
    {
        Serial.println("RTC was not actively running, starting now");
        Rtc.SetIsRunning(true);
    }

    RtcDateTime now = Rtc.GetDateTime();
    if (now < compiled) 
    {
        Serial.println("RTC is older than compile time!  (Updating DateTime)");
        Rtc.SetDateTime(compiled);
    }
    else if (now > compiled) 
    {
        Serial.println("RTC is newer than compile time. (this is expected)");
    }
    else if (now == compiled) 
    {
        Serial.println("RTC is the same as compile time! (not expected but all is fine)");
    }

    // never assume the Rtc was last configured by you, so
    // just clear them to your needed state
    Rtc.SetSquareWavePin(DS1307SquareWaveOut_Low); 


    
  lmd.setEnabled(true);
  lmd.setIntensity(2);   // 0 = low, 10 = high
}

int x=0, y=0;   // start top left

const byte MAX7219_Dot_Matrix_font [95] [8]= {
{0,0,0,0,0,0,0,0}, // SPACE
{0x10,0x18,0x18,0x18,0x18,0x00,0x18,0x18}, // EXCL
{0x28,0x28,0x08,0x00,0x00,0x00,0x00,0x00}, // QUOT
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{ 0x02, 0x03, 0x01, 0x03, 0x02, 0x03, 0x01, 0x00 }, // '~'
};  //  end of MAX7219_Dot_Matrix_font

RtcDateTime time_to_update;
int count=0;

void loop()
{  
  count++;
  Serial.println(count);
  if(count > 20)
  {
    count = 0;
    RtcDateTime now = Rtc.GetDateTime();
    time_to_update = now;
  }
  printDateTime(time_to_update);
}

void drawString(char* text, int len, int x, int y )
{
  for( int idx = 0; idx < len; idx ++ )
  {
    char c = text[idx];// - 32;
    if((c >= ' ') && (c <= 126))
    {
      c = c - ' ';
        if( x + idx * 8  > LEDMATRIX_WIDTH )
      return;

    if( 8 + x + idx * 8 > 0 )
    {
      drawLetter( MAX7219_Dot_Matrix_font[c], x + idx * 8, y, 8, 8 );
    }
    }
  }
}

void drawLetter( byte* Letter, int x, int y, int width, int height )
{
  byte mask = B10000000;

  for( int iy = 0; iy < height; iy++ )
  {
    for( int ix = 0; ix < width; ix++ )
    {
      lmd.setPixel(x + ix, y + iy, (bool)(Letter[iy] & mask ));
      mask = mask >> 1;
    }
    mask = B10000000;
  }
}

#define countof(a) (sizeof(a) / sizeof(a[0]))

void printDateTime(const RtcDateTime& dt)
{
    char datestring[20];

    snprintf_P(datestring, 
            countof(datestring),
            PSTR("%02u:%02u:%02u"),
//            dt.Month(),
//            dt.Day(),
//            dt.Year(),
            dt.Hour(),
            dt.Minute(),
            dt.Second() );
              int len = strlen(datestring);
  drawString(datestring, len, x, 0);
  lmd.display();
  if( --x < len * -8 ) {
    x = LEDMATRIX_WIDTH;
  }
  delay(ANIM_DELAY);
}
